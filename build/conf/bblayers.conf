## build/conf/bblayers.conf
```bitbake
# POKY_BBLAYERS_CONF_VERSION is increased each time build/conf/bblayers.conf
# changes incompatibly
POKY_BBLAYERS_CONF_VERSION = "2"

BBPATH = "${TOPDIR}"
BBFILES ?= ""

YOCTOROOT = "${@os.path.abspath(os.path.join("${TOPDIR}", os.pardir))}"

BBLAYERS ?= " \
  ${YOCTOROOT}/layers/poky/meta \
  ${YOCTOROOT}/layers/poky/meta-poky \
  ${YOCTOROOT}/layers/poky/meta-yocto-bsp \
  ${YOCTOROOT}/layers/bsp/meta-sunxi \
  ${YOCTOROOT}/layers/third-party/meta-openembedded/meta-oe \
  ${YOCTOROOT}/layers/third-party/meta-openembedded/meta-python \
  ${YOCTOROOT}/layers/third-party/meta-rauc \
  ${YOCTOROOT}/layers/third-party/meta-rauc-community/meta-rauc-sunxi \
  ${YOCTOROOT}/layers/third-party/meta-wifi-credentials/systemd-networkd \
  "
```
